ENTRY(_start)

SECTIONS
{
    . = 1M;

    .text :
    {
        . = ALIGN(8);

        KEEP(*(.multiboot))

        *(.text*)
    }

    .rodata :
    {
        *(.rodata*)
    }

    .data :
    {
        *(.data*)
    }

    .bss :
    {
        . = ALIGN(16);

        *(COMMON)
        *(.bss*)
    }

    /DISCARD/ :
    {
        *(.eh_frame)
        *(.comment)
        *(.note*)
    }
}
